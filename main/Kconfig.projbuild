## main/Kconfig.projbuild
```kconfig
menu "CircleMonitor Configuration"
    # Find your TZ string from: https://github.com/nayarsystems/posix_tz_db/blob/master/zones.csv
    config ESP_NTP_TZ
        string "NTP timezone"
        default "CET-1CEST,M3.5.0,M10.5.0/3"
        help
            Timezone.

    config ESP_NTP_SERVER
        string "NTP server host"
        default "pool.ntp.org"
        help
            NTP server hostname.

    config ESP_SYSLOG_SERVER
        string "Syslog server"
        default ""
        help
            Syslog server hostname. UDP only on port 514.

    config ESP_LHWM_URL
        string "Libre Hardware Monitor URL"
        default "http://pc.localdomain:8085/Sensor?action=Get&id="
        help
            Libre Hardware Monitor sensor URL.
            
endmenu
```

## sdkconfig.defaults
```kconfig
CONFIG_LV_PREDEFINED_DISPLAY_NONE=y
CONFIG_LV_TFT_DISPLAY_CONTROLLER_GC9A01=y
CONFIG_LV_TFT_DISPLAY_PROTOCOL_SPI=y
CONFIG_LV_DISPLAY_ORIENTATION_PORTRAIT=y
CONFIG_LV_DISPLAY_ORIENTATION=0
CONFIG_LV_PREDEFINED_PINS_NONE=y
CONFIG_LV_TFT_DISPLAY_USER_CONTROLLER_GC9A01=y
CONFIG_LV_TFT_DISPLAY_SPI2_HOST=y
CONFIG_LV_TFT_DISPLAY_SPI_TRANS_MODE_SIO=y
CONFIG_LV_TFT_DISPLAY_SPI_HALF_DUPLEX=y
CONFIG_LV_TFT_CUSTOM_SPI_CLK_DIVIDER=2
CONFIG_LV_DISP_SPI_MOSI=7
CONFIG_LV_DISP_SPI_CLK=6
CONFIG_LV_DISPLAY_USE_SPI_CS=y
CONFIG_LV_DISP_SPI_CS=10
CONFIG_LV_DISPLAY_USE_DC=y
CONFIG_LV_DISP_PIN_DC=2
CONFIG_LV_DISP_USE_RST=y
CONFIG_LV_DISP_PIN_RST=1
CONFIG_LV_DISP_PIN_BUSY=21
CONFIG_LV_DISP_BACKLIGHT_SWITCH=y
CONFIG_LV_BACKLIGHT_ACTIVE_LVL=y
CONFIG_LV_DISP_PIN_BCKL=3
CONFIG_LV_I2C_DISPLAY_PORT=0
CONFIG_LV_COLOR_DEPTH_16=y
CONFIG_LV_COLOR_DEPTH=16
CONFIG_LV_COLOR_16_SWAP=y
CONFIG_LV_INVERT_COLORS=y
CONFIG_PARTITION_TABLE_CUSTOM_FILENAME="partitions.csv"
CONFIG_PARTITION_TABLE_OFFSET=0x8000
CONFIG_PARTITION_TABLE_MD5=y
CONFIG_LV_FONT_MONTSERRAT_14=y
CONFIG_LV_FONT_MONTSERRAT_16=y
CONFIG_LV_FONT_MONTSERRAT_18=y
CONFIG_LV_FONT_MONTSERRAT_20=y
CONFIG_LV_FONT_MONTSERRAT_22=y
CONFIG_LV_FONT_MONTSERRAT_24=y
CONFIG_LV_FONT_MONTSERRAT_26=y
CONFIG_LV_FONT_MONTSERRAT_28=y
CONFIG_LV_FONT_MONTSERRAT_30=y
CONFIG_LV_FONT_MONTSERRAT_32=y
CONFIG_LV_FONT_MONTSERRAT_34=y
CONFIG_LV_FONT_MONTSERRAT_36=y
CONFIG_LV_FONT_MONTSERRAT_38=y
CONFIG_LV_FONT_MONTSERRAT_40=y
CONFIG_LV_FONT_MONTSERRAT_42=y
CONFIG_LV_FONT_MONTSERRAT_44=y
CONFIG_LV_FONT_MONTSERRAT_46=y
CONFIG_LV_FONT_MONTSERRAT_48=y
DEFAULT_AP_SSID="CircleMonitor"
DEFAULT_AP_PASSWORD="12345678"
```
